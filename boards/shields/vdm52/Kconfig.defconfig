## boards/shields/vdm52/Kconfig.defconfig
```kconfig
if SHIELD_VDM52_LEFT

config ZMK_KEYBOARD_NAME
    default "VDM52"

config ZMK_SPLIT_BLE_ROLE_CENTRAL
    default y

endif

if SHIELD_VDM52_LEFT || SHIELD_VDM52_RIGHT

config ZMK_SPLIT
    default y

endif
```

## boards/shields/vdm52/Kconfig.shield
```kconfig
config SHIELD_VDM52_LEFT
  def_bool $(shields_list_contains,vdm52_left)

config SHIELD_VDM52_RIGHT
  def_bool $(shields_list_contains,vdm52_right)
```
